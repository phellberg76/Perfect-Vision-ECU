## firmware/main/Kconfig.projbuild
```kconfig
menu "Perfect Vision ECU Configuration"

    choice PV_CAN_BITRATE
        prompt "CAN Bus Bitrate"
        default PV_CAN_BITRATE_250K
        help
            Select the CAN bus bitrate for both CAN channels.
            250 kbps is common for agricultural equipment (ISOBUS).

        config PV_CAN_BITRATE_125K
            bool "125 kbps"
        config PV_CAN_BITRATE_250K
            bool "250 kbps (ISOBUS standard)"
        config PV_CAN_BITRATE_500K
            bool "500 kbps"
        config PV_CAN_BITRATE_1M
            bool "1 Mbps"
    endchoice

    config PV_CAN_BUFFER_SIZE
        int "CAN message buffer size"
        default 256
        range 64 1024
        help
            Number of CAN messages to buffer before BLE transmission.
            Larger buffer reduces chance of message loss at high bus loads.

    config PV_BLE_DEVICE_NAME_PREFIX
        string "BLE device name prefix"
        default "PerfectVision"
        help
            Prefix for the BLE device name. The MAC address suffix
            will be appended automatically.

    menu "GPIO Pin Configuration"
        config PV_CAN0_TX_GPIO
            int "CAN0 (TWAI) TX GPIO"
            default 4
            range 0 48

        config PV_CAN0_RX_GPIO
            int "CAN0 (TWAI) RX GPIO"
            default 5
            range 0 48

        config PV_MCP2515_CS_GPIO
            int "MCP2515 SPI CS GPIO"
            default 10
            range 0 48

        config PV_MCP2515_MOSI_GPIO
            int "MCP2515 SPI MOSI GPIO"
            default 11
            range 0 48

        config PV_MCP2515_CLK_GPIO
            int "MCP2515 SPI CLK GPIO"
            default 12
            range 0 48

        config PV_MCP2515_MISO_GPIO
            int "MCP2515 SPI MISO GPIO"
            default 13
            range 0 48

        config PV_MCP2515_INT_GPIO
            int "MCP2515 Interrupt GPIO"
            default 9
            range 0 48
    endmenu

endmenu
```

## firmware/sdkconfig.defaults
```kconfig
# Perfect Vision ECU - ESP-IDF SDK Configuration Defaults
# Target: ESP32-S3

# Target selection
CONFIG_IDF_TARGET="esp32s3"

# Flash configuration
CONFIG_ESPTOOLPY_FLASHSIZE_4MB=y
CONFIG_ESPTOOLPY_FLASHMODE_QIO=y
CONFIG_ESPTOOLPY_FLASHFREQ_80M=y

# Partition table with OTA support
CONFIG_PARTITION_TABLE_CUSTOM=y
CONFIG_PARTITION_TABLE_CUSTOM_FILENAME="partitions.csv"

# Bootloader - OTA rollback support
CONFIG_BOOTLOADER_APP_ROLLBACK_ENABLE=y

# Bluetooth - NimBLE stack (more memory efficient than Bluedroid)
CONFIG_BT_ENABLED=y
CONFIG_BT_NIMBLE_ENABLED=y
CONFIG_BT_CONTROLLER_ENABLED=y

# NimBLE configuration
CONFIG_BT_NIMBLE_MAX_CONNECTIONS=1
CONFIG_BT_NIMBLE_ATT_PREFERRED_MTU=512
CONFIG_BT_NIMBLE_ROLE_CENTRAL=n
CONFIG_BT_NIMBLE_ROLE_OBSERVER=n
CONFIG_BT_NIMBLE_ROLE_BROADCASTER=n
CONFIG_BT_NIMBLE_ROLE_PERIPHERAL=y
CONFIG_BT_NIMBLE_NVS_PERSIST=y

# WiFi configuration (for OTA)
CONFIG_ESP_WIFI_ENABLED=y
CONFIG_ESP_WIFI_STATIC_RX_BUFFER_NUM=10
CONFIG_ESP_WIFI_DYNAMIC_RX_BUFFER_NUM=32
CONFIG_ESP_WIFI_TX_BUFFER_TYPE=1
CONFIG_ESP_WIFI_DYNAMIC_TX_BUFFER_NUM=32

# HTTP client for OTA
CONFIG_ESP_HTTP_CLIENT_ENABLE_HTTPS=y
CONFIG_ESP_HTTP_CLIENT_ENABLE_BASIC_AUTH=n

# Certificate bundle for HTTPS
CONFIG_MBEDTLS_CERTIFICATE_BUNDLE=y
CONFIG_MBEDTLS_CERTIFICATE_BUNDLE_DEFAULT_FULL=y

# TWAI (CAN) driver
CONFIG_TWAI_ISR_IN_IRAM=y

# FreeRTOS configuration
CONFIG_FREERTOS_HZ=1000
CONFIG_FREERTOS_USE_TICKLESS_IDLE=n

# Logging
CONFIG_LOG_DEFAULT_LEVEL_INFO=y
CONFIG_LOG_MAXIMUM_LEVEL_DEBUG=y

# Optimization
CONFIG_COMPILER_OPTIMIZATION_PERF=y

# Watchdog
CONFIG_ESP_TASK_WDT_TIMEOUT_S=10

# Power management (disabled for low latency)
CONFIG_PM_ENABLE=n

# SPI configuration
CONFIG_SPI_MASTER_ISR_IN_IRAM=y

# Memory optimization
CONFIG_ESP_SYSTEM_EVENT_TASK_STACK_SIZE=3072
CONFIG_ESP_MAIN_TASK_STACK_SIZE=4096

# WiFi/BLE coexistence
CONFIG_ESP32_WIFI_SW_COEXIST_ENABLE=y
CONFIG_ESP_COEX_SW_COEXIST_ENABLE=y
```
